## Kconfig
```kconfig
config ARCH
	string
	option env="ARCH"

config KERNELVERSION
	string
	option env="KERNELVERSION"

menu "General setup"
config LOCALVERSION
	string "Local version - append to kernel release"
	default "-default"
	---help---
	  Append an extra string to the end of your kernel version.
	  This will show up when you type uname, for example.
	  The string you set here will be appended after the contents of
	  any files with a filename matching localversion* in your
	  object and source tree, in that order.  Your total string can
	  be a maximum of 64 characters.

config OPTIMIZE_FOR_SIZE
	bool "Optimize for size (Look out for broken compilers!)"
	default n
	---help---
	  Enabling this option will pass "-Os" instead of "-O2" to gcc
	  resulting in a smaller code.

	  WARNING: some versions of gcc may generate incorrect code with this
	  option. If problems are observed, a gcc upgrade may be needed.

config FRAME_POINTER
	bool "Compile with frame pointers"
	default n
	---help---
	  Enabling this will compile code with frame pointers (larger and slower code).

config NULL_DEREFER
	bool "Null pointer dereferencing"
	default y
	---help---
	  Enable null pointer dereferencing (*NULL) in user-space code.

	  NOTE: This hack is neccessary because of legacy code which does null
	        pointer dereferencing an expects that *NULL==0. Should be removed
	        since it makes at least debugging more difficult.
	        Note that this option works only for separate I&D linkage type (for
	        servers or drivers). Null dereferncing in case of common I&D linkage
	        type can result in unpredictable behaviour.

config NR_PROCS
	int "Number of slots in the table for non-kernel processes"
	default 100
	---help---
	  Specify the number of slots in the table for non-kernel processes. User
	  processes share the same properties and count for one.

config NR_SYS_PROCS
	int "Number of slots in the table with special privileges"
	default 32
	---help---
	  Specify the number of slots in the table for non-kernel processes with
	  special privileges.

config NR_CTRLRS
	int "Number of controller tasks (/dev/cN device classes)"
	default 2
	---help---
	  Number of controller tasks (/dev/cN device classes).
endmenu
```

## arch/x86/Kconfig
```kconfig
# Select 32 or 64 bit

# n/a
config 64BIT
	def_bool n

config X86_32
	def_bool !64BIT

config X86_64
	def_bool 64BIT

### Arch settings
config X86
	def_bool y

# x86 configuration
mainmenu "Nucleos Configuration for x86"

config ARCH_DEFCONFIG
	string
	default "arch/x86/configs/i386_defconfig" if X86_32
	default "arch/x86/configs/x86_64_defconfig" if X86_64

config ARCH_SELECT_MEMORY_MODEL
	def_bool y

config PAGE_OFFSET
	hex
	default 0x00000000
	depends on X86_32


config ARCH_SUPPORTS_OPTIMIZED_INLINING
	def_bool y

source "Kconfig"

# Kernel options
source "arch/x86/kernel/Kconfig"

menu "Processor type and features"

source "arch/x86/Kconfig.cpu"
source "kernel/Kconfig.hz"
source "mm/Kconfig"

config SMP
	bool "Symmetric multi-processing support"
	default n
	---help---
	  NOTE: NOT IMPLEMETED AD INTERIM

	  This enables support for systems with more than one CPU. If you have
	  a system with only one CPU, like most personal computers, say N. If
	  you have a system with more than one CPU, say Y.

	  If you don't know what to do here, say N.

config X86_UP_APIC
	bool "Local APIC support on uniprocessors"
	depends on X86_32 && !SMP
	---help---
	  A local APIC (Advanced Programmable Interrupt Controller) is an
	  integrated interrupt controller in the CPU. If you have a single-CPU
	  system which has a processor with a local APIC, you can say Y here to
	  enable and use it. The local APIC supports CPU-generated self-interrupts
	  (timer, performance counters), and the NMI watchdog which detects hard
	  lockups.

config X86_UP_IOAPIC
	bool "IO-APIC support on uniprocessors"
	depends on X86_UP_APIC
	---help---
	  An IO-APIC (I/O Advanced Programmable Interrupt Controller) is an
	  SMP-capable replacement for PC-style interrupt controllers. Most
	  SMP systems and many recent uniprocessor systems have one.

	  If you have a single-CPU system with an IO-APIC, you can say Y here
	  to use it.

config X86_LOCAL_APIC
	def_bool y
	depends on SMP || X86_UP_APIC

config DEBUG_X86_LOCAL_APIC
	def_bool n
	depends on X86_LOCAL_APIC
	---help---
	  Debug APIC.

config X86_IO_APIC
	def_bool y
	depends on SMP || X86_UP_APIC

config PHYSICAL_START
	hex "Physical address where the kernel is loaded"
	default "0x1000000"
	---help---
	  This gives the physical address where the kernel is loaded.

	  Don't change this unless you know what you are doing.

config PHYSICAL_ALIGN
	hex "Alignment value to which kernel should be aligned" if X86_32
	default "0x1000000"
	range 0x2000 0x1000000
	---help---
	  This value puts the alignment restrictions on physical address
	  where kernel is loaded and run from. Kernel is compiled for an
	  address which meets above alignment restriction.

	  Don't change this unless you know what you are doing.

endmenu

menu "Bus options (PCI etc.)"

config PCI
	bool "PCI support"
	default y
	---help---
	  Find out whether you have a PCI motherboard. PCI is the name of a
	  bus system, i.e. the way the CPU talks to the other stuff inside
	  your box. Other bus systems are ISA, EISA, MicroChannel (MCA) or
	  VESA. If you have PCI, say Y, otherwise N.

# PCI driver
source "drivers/pci/Kconfig"

endmenu


# Servers (includes also debug options if any)
source "arch/x86/servers/Kconfig"

# Drivers (includes also debug options if any)
source "drivers/Kconfig"

menu "Linkage"
# @nucleos: add some usefull configs
endmenu

# Hacking/debugging (common for all components, generic + arch if any)
source "arch/x86/Kconfig.debug"
```

## arch/x86/Kconfig.cpu
```kconfig
choice
	prompt "Processor family"
	default M386 if X86_32

config M386
	bool "386"
	depends on X86_32
	---help---
	  This is the processor type of your CPU. This information is used for
	  optimizing purposes. In order to compile a kernel that can run on
	  all x86 CPU types (albeit not optimally fast), you can specify
	  "386" here.

	  The kernel will not necessarily run on earlier architectures than
	  the one you have chosen, e.g. a Pentium optimized kernel will run on
	  a PPro, but not necessarily on a i486.

	  Here are the settings recommended for greatest speed:
	  - "386" for the AMD/Cyrix/Intel 386DX/DXL/SL/SLC/SX, Cyrix/TI
	    486DLC/DLC2, and UMC 486SX-S.  Only "386" kernels will run on a 386
	    class machine.
	  - "486" for the AMD/Cyrix/IBM/Intel 486DX/DX2/DX4 or
	    SL/SLC/SLC2/SLC3/SX/SX2 and UMC U5D or U5S.
	  - "586" for generic Pentium CPUs lacking the TSC
	    (time stamp counter) register.
	  - "Pentium-Classic" for the Intel Pentium.
	  - "Pentium-MMX" for the Intel Pentium MMX.
	  - "Pentium-Pro" for the Intel Pentium Pro.
	  - "Pentium-II" for the Intel Pentium II or pre-Coppermine Celeron.
	  - "Pentium-III" for the Intel Pentium III or Coppermine Celeron.
	  - "Pentium-4" for the Intel Pentium 4 or P4-based Celeron.
	  - "K6" for the AMD K6, K6-II and K6-III (aka K6-3D).
	  - "Athlon" for the AMD K7 family (Athlon/Duron/Thunderbird).
	  - "Crusoe" for the Transmeta Crusoe series.
	  - "Efficeon" for the Transmeta Efficeon series.
	  - "Winchip-C6" for original IDT Winchip.
	  - "Winchip-2" for IDT Winchips with 3dNow! capabilities.
	  - "GeodeGX1" for Geode GX1 (Cyrix MediaGX).
	  - "Geode GX/LX" For AMD Geode GX and LX processors.
	  - "CyrixIII/VIA C3" for VIA Cyrix III or VIA C3.
	  - "VIA C3-2" for VIA C3-2 "Nehemiah" (model 9 and above).
	  - "VIA C7" for VIA C7.

	  If you don't know what to do, choose "386".

config M486
	bool "486"
	depends on X86_32
	---help---
	  Select this for a 486 series processor, either Intel or one of the
	  compatible processors from AMD, Cyrix, IBM, or Intel.  Includes DX,
	  DX2, and DX4 variants; also SL/SLC/SLC2/SLC3/SX/SX2 and UMC U5D or
	  U5S.

config M586
	bool "586/K5/5x86/6x86/6x86MX"
	depends on X86_32
	---help---
	  Select this for an 586 or 686 series processor such as the AMD K5,
	  the Cyrix 5x86, 6x86 and 6x86MX.  This choice does not
	  assume the RDTSC (Read Time Stamp Counter) instruction.

config M586TSC
	bool "Pentium-Classic"
	depends on X86_32
	---help---
	  Select this for a Pentium Classic processor with the RDTSC (Read
	  Time Stamp Counter) instruction for benchmarking.

config M586MMX
	bool "Pentium-MMX"
	depends on X86_32
	---help---
	  Select this for a Pentium with the MMX graphics/multimedia
	  extended instructions.

config M686
	bool "Pentium-Pro"
	depends on X86_32
	---help---
	  Select this for Intel Pentium Pro chips.  This enables the use of
	  Pentium Pro extended instructions, and disables the init-time guard
	  against the f00f bug found in earlier Pentiums.

endchoice

config X86_GENERIC
	bool "Generic x86 support"
	depends on X86_32
	---help---
	  Instead of just including optimizations for the selected
	  x86 variant (e.g. PII, Crusoe or Athlon), include some more
	  generic optimizations as well. This will make the kernel
	  perform better on x86 CPUs other than that selected.

	  This is really intended for distributors who need more
	  generic optimizations.

#
# Define implied options from the CPU selection here

config X86_BSWAP
	def_bool y
	depends on X86_32 && !M386

config X86_ALIGNMENT_16
	def_bool y
	depends on MWINCHIP3D || MWINCHIPC6 || MCYRIXIII || X86_ELAN || MK6 || M586MMX || M586TSC || M586 || M486 || MVIAC3_2 || MGEODEGX1

# this should be set for all -march=.. options where the compiler
# generates cmov.
config X86_CMOV
	def_bool y
	depends on (MK8 || MK7 || MCORE2 || MPENTIUM4 || MPENTIUMM || MPENTIUMIII || MPENTIUMII || M686 || MVIAC3_2 || MVIAC7 || MCRUSOE || MEFFICEON || X86_64)
```

## arch/x86/kernel/Kconfig
```kconfig
# Kernel options
menu "Kernel options"

# common kernel configs
source "kernel/Kconfig"

# Hacking/debugging (include commong + x86 if any)
source "arch/x86/kernel/Kconfig.debug"

endmenu
```

## arch/x86/kernel/Kconfig.debug
```kconfig
### Kernel hacking/debugging (kernel generic + arch.specific)
menu "Kernel hacking"

config BOOT_VERBOSE
	bool "Boot verbose"
	default y

### common kernel debug options
source "kernel/Kconfig.debug"

endmenu
```

## arch/x86/monitor/Kconfig
```kconfig
menu "Legacy boot monitor"

config BOOT_VERBOSE
	bool "Boot verbose"
	default y
endmenu
```

## arch/x86/servers/Kconfig
```kconfig
# common + arch. configs for servers
menu "Servers"

source "servers/Kconfig"
source "servers/fs/vfs/Kconfig"
# Note: vm's arch Kconfig includes generic Kconfig if any
source "arch/x86/servers/vm/Kconfig"

# Hacking/debugging (generic + arch if any)
source "arch/x86/servers/Kconfig.debug"

endmenu
```

## arch/x86/servers/Kconfig.debug
```kconfig
# Generic/common + arch. specific debug (if any) configs for servers
# Note: Don't include Kconfig.debug files of particular servers. Each
#       server must include its Kconfig.debug itself into Kconfig.
menu "Servers hacking/debugging"

# Generic debug options
source "servers/Kconfig.debug"

# Arch debug options

endmenu
```

## arch/x86/servers/vm/Kconfig
```kconfig
menu "VM server"

# arch-independent part
source "servers/vm/Kconfig"

# VM hacking and debugging
source "arch/x86/servers/vm/Kconfig.debug"

endmenu
```

## drivers/Kconfig
```kconfig
menu "Device drivers"

source "drivers/memory/Kconfig"
source "drivers/tty/Kconfig"

# Hacking/debugging for drivers (common)
source drivers/Kconfig.debug

endmenu
```

## drivers/memory/Kconfig
```kconfig
menu "Memory"
config BUILTIN_INITRD
	bool "Initial ramdisk built into memory driver"
	default n
	---help---
	  Say Y if you want to have initial ramdisk built
	  into memory driver. Helpful for small embedded or
	  diskless systems.

	  If unsure say N here.

config INITRD_FSIMG_SOURCE
	string
	prompt "The path to filesystem image which shall be built into driver"
	depends on BUILTIN_INITRD
	default "init/initrd.minixfs"
	---help---
	  Specify the path (on host) to filesystem image (consists all servers,
	  drivers etc. that are needed in initial ramdisk). Path can be relative
	  to source tree or an absolute path. 

config INITRD_TARGET_PATH
	string
	prompt "The path to initial ramdisk on target filesystem"
	depends on !BUILTIN_INITRD
	default "/boot/initrd"
	---help---
	  Specify the path to initial ramdisk image on target filesystem. Path
	  must be absolute.

endmenu
```

## drivers/pci/Kconfig
```kconfig
config NR_PCIBUS
	int "Number of PCI buses"
	default 40
	depends on PCI
	---help---
	  Specify the max. number of PCI bus.

config NR_PCIDEV
	int "Number of PCI devices"
	default 50
	depends on PCI
	---help---
	  Specify the max. number of PCI devices.
```

## drivers/tty/Kconfig
```kconfig
menu "Serial devices and TTY"
config NR_CONS
	int "Number of system consoles"
	range 1 8
	default 4
	---help---
	  Specify the number (from 1 to 8) of system consoles.

config NR_RS_LINES
	int "Number of rs232 terminals"
	range 0 4
	default 4
	---help---
	  Specify the number (from 0 to 4) of RS232 terminals.

config NR_PTYS
	int "Number of pseudo terminals"
	range 0 64
	default 32
	---help---
	  Specify the number (from 0 to 64) of pseudo terminals.
endmenu
```

## kernel/Kconfig.debug
```kconfig
config DEBUG_KERNEL
	bool "Kernel debugging"
	default y
	---help---
	  Say Y if want to debug kernel.

config DEBUG_KERNEL_IPC_WARNINGS
	bool "Kernel IPC warnings debugging"
	depends on DEBUG_KERNEL
	default y
	---help---
	  Say Y if want to debug kernel IPC warnings.
	  Enable prints such as:
	    . send/receive failed due to deadlock or dead source or dead destination
	    . trap not allowed
	    . bogus message pointer
	    . kernel call number not allowed by this process

	  Of course the call still fails, but nothing is printed if these warnings
	  are disabled.

config DEBUG_KERNEL_SCHED_CHECK
	bool "Sanity check for scheduling queues"
	depends on DEBUG_KERNEL
	default n
	---help---
	  Say Y if you want a sanity check of scheduling queues.

config DEBUG_KERNEL_TIME_LOCKS
	bool "Debug time spent in locks"
	depends on DEBUG_KERNEL
	default y
	---help---
	  Say Y if you want to measure time spent in locks.

config DEBUG_KERNEL_LOCK_CHECK
	bool "Interrupt lock/unlock sanity checking"
	depends on DEBUG_KERNEL
	default y
	---help---
	  Say Y if you want interrupt lock/unlock sanity checking.

config DEBUG_KERNEL_VMASSERT
	bool "Sanity checking regarding virtual memory"
	depends on DEBUG_KERNEL
	default n
	---help---
	  Say Y if you want interrupt lock/unlock sanity checking.

config DEBUG_KERNEL_STATS_PROFILE
	bool "Statistical profiling"
	default n
	---help---
	  Say Y here if you want to enable statistical profiling.

config DEBUG_KERNEL_CALL_PROFILE
	bool "Call profiling"
	default n
	---help---
	  Say Y here if you want to enable call profiling.

	  WARNING: This options requires compiler support which is
	           not available yet.

config DEBUG_KERNEL_STACK_CHECK
	bool "Check tasks' stack"
	default n
	---help---
	  Say Y here if you want to check tasks' stack.

config DEBUG_KERNEL_TRACE
	bool "Trace the kernel"
	default n
	---help---
	  Say Y here if you want to trace the kernel.
```
