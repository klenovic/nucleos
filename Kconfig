## kernel/system/Kconfig
```kconfig
config KERNEL_NR_IRQ_HOOKS
	int "Number of interrupts hooks"
	default 16
	---help---
	  Number of interrupt hooks.

config KERNEL_VDEVIO_BUF_SIZE
	int "Maximum number of elements per VDEVIO request"
	default 64
	---help---
	  Maximum number of elements per VDEVIO request.

config KERNEL_VCOPY_VEC_SIZE
	int "Maximum number of elements per VCOPY request"
	default 16
	---help---
	  Maximum number of elements per VCOPY request.

config KERNEL_P_NAME_LEN
	int "Length of program names stored in the process table"
	default 8
	---help---
	  Length of program names stored in the process table.

config KERNEL_MESSAGES_BUFFER_SIZE
	int "Size of buffer for kernel messages"
	default 10000
	---help---
	  Size of buffer for kernel messages.

config KERNEL_VM_NOPAGEZERO
	bool "First page of code and data unmapped"
	default y
	---help---
	  Say Y if you want to compile the kernel so that first page
	  of code and data can be unmapped.

	  If unsure say Y here.
```

## mm/Kconfig
```kconfig
config SELECT_MEMORY_MODEL
  def_bool y
  depends on ARCH_SELECT_MEMORY_MODEL

choice
  prompt "Memory model"
  depends on SELECT_MEMORY_MODEL
  default MEMORY_MODEL_FLAT

config MEMORY_MODEL_FLAT
  bool "Flat memory"
  ---help---
    Flat memory model.

endchoice
```

## servers/Kconfig.debug
```kconfig
# Common for all servers i.e. may apply on all servers
 
config DEBUG_SERVERS
	bool "Servers debugging"
	default y
	---help---
	  Say Y if you want to debug servers. These options may
	  apply on all servers. Servers may have their own debug
	  options independent from these here (see debug options
	  for particular server).

config DEBUG_SERVERS_SYSCALL_STATS
	bool "Enable the counting of system calls in PM and FS"
	depends on DEBUG_SERVERS
	default n
	---help---
	  Say Y here if you want to enable the counting of system calls 
	  in PM and FS.

config DEBUG_SERVERS_STATS_PROFILE
	bool "Statistical profiling"
	depends on DEBUG_SERVERS && DEBUG_KERNEL_STATS_PROFILE
	default n
	---help---
	  Say Y if you want to enable statistical profiling.

config DEBUG_SERVERS_CALL_PROFILE
	bool "Statistical profiling"
	depends on DEBUG_SERVERS && DEBUG_KERNEL_CALL_PROFILE
	default n
	---help---

	  Say Y if you want to enable call profiling.

	  WARNING: This options requires compiler support which is
	           not available yet.
```

## servers/fs/vfs/Kconfig.debug
```kconfig
config DEBUG_VFS
	bool "VFS debugging"
	default n
	---help---
	  Say Y if you want to debug VFS server.

config DEBUG_VFS_BINFMT
	bool "Debug binary formats processing"
	default n
	depends on DEBUG_VFS
	---help---
	  Say Y if want to debug processing of various binary formats.

config DEBUG_VFS_ELF32
	bool "ELF32 handling debbug"
	depends on DEBUG_VFS_BINFMT
	default n
	---help---
	  Say Y if you want to debug processing of ELF32 binaries.

config DEBUG_VFS_AOUT
	bool "AOUT handling debbug"
	depends on DEBUG_VFS_BINFMT
	default n
	---help---
	  Say Y if you want to debug processing of AOUT binaries.
```

## servers/vfs/Kconfig
```kconfig
menu "VFS server"
config VFS_ELF32_BINFMT
	bool "ELF32 binary format support"
	default y
	---help---
	  Say Y if want a ELF32 binary format support.

config VFS_ELF32_STACKSIZE
	hex "Stack size"
	depends on VFS_ELF32_BINFMT
	default 0x20000
	---help---
	  Set the default stack size for ELF32 binaries.

config VFS_AOUT_BINFMT
	bool "AOUT binary format support"
	default y
	---help---
	  Say Y if want a AOUT binary format support.

# VFS hacking and debugging
source "servers/vfs/Kconfig.debug"

endmenu
```

## servers/vm/Kconfig.debug
```kconfig
config DEBUG_VM
	bool "VM debugging"
	default n
	---help---
	  Say Y if you want to debug VM server.

config DEBUG_VM_VERBOSE_LEVEL
	int "Verbose level"
	default 0
	depends on DEBUG_VM
	---help---
	  Level of how noisy we are supposed to be.
```
